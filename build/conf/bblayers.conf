## build/conf/bblayers.conf
```bitbake
# POKY_BBLAYERS_CONF_VERSION is increased each time build/conf/bblayers.conf
# changes incompatibly
POKY_BBLAYERS_CONF_VERSION = "2"

BBPATH = "${TOPDIR}"
BBFILES ?= ""

BBLAYERS ?= " \
  /home/spstack/repos/evolution-sim-yocto/meta \
  /home/spstack/repos/evolution-sim-yocto/meta-poky \
  /home/spstack/repos/evolution-sim-yocto/meta-raspberrypi \
  /home/spstack/repos/evolution-sim-yocto/meta-yocto-bsp \
  /home/spstack/repos/evolution-sim-yocto/meta-rust-bin \
  /home/spstack/repos/evolution-sim-yocto/meta-evolutionsim \
  "
```
